#include <dt-bindings/zmk/backlight.h> 


&{ 
    chosen {
        zmk,backlight = &backlight;
    };

    backlight: backlight {
        compatible = "pwm-backlight";
        pwms = <&pwm0 0 50000>;
        brightness-levels = <0 4 8 16 32 64 128 255>;
        default-brightness-level = <4>;
    };
};

&pwm0 {
    status = "okay";
};